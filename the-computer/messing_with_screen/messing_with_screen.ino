/**************************************************************************
 This is an example for our Monochrome OLEDs based on SSD1306 drivers

 Pick one up today in the adafruit shop!
 ------> http://www.adafruit.com/category/63_98

 This example is for a 128x64 pixel display using I2C to communicate
 3 pins are required to interface (two I2C and one reset).

 Adafruit invests time and resources providing this open
 source code, please support Adafruit and open-source
 hardware by purchasing products from Adafruit!

 Written by Limor Fried/Ladyada for Adafruit Industries,
 with contributions from the open source community.
 BSD license, check license.txt for more information
 All text above, and the splash screen below must be
 included in any redistribution.
 **************************************************************************/
// 'noti', 128x64px
const unsigned char notification [] PROGMEM = {
  0x00, 0x00, 0x00, 0x00, 0x00, 0x00, 0x00, 0x00, 0x00, 0x00, 0x00, 0x00, 0x00, 0x00, 0x00, 0x00, 
  0x00, 0x00, 0x00, 0x00, 0x00, 0x00, 0x00, 0x00, 0x00, 0x00, 0x00, 0x00, 0x00, 0x00, 0x00, 0x00, 
  0x00, 0x00, 0x00, 0x00, 0x00, 0x00, 0x00, 0x00, 0x00, 0x00, 0x00, 0x00, 0x00, 0x00, 0x00, 0x00, 
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  0x00, 0x00, 0x00, 0x00, 0x00, 0x00, 0x00, 0x00, 0x00, 0x00, 0x00, 0x00, 0x00, 0x00, 0x00, 0x00
};

#include <SPI.h>
#include <Wire.h>
#include <Adafruit_GFX.h>
#include <Adafruit_SSD1306.h>

#define SCREEN_WIDTH 128 // OLED display width, in pixels
#define SCREEN_HEIGHT 64 // OLED display height, in pixels

#define LIGHT_PIN  2
#define BUZZER_PIN  3
#define SWITCH_PIN 8

// Declaration for an SSD1306 display connected to I2C (SDA, SCL pins)
// The pins for I2C are defined by the Wire-library. 
// On an arduino UNO:       A4(SDA), A5(SCL)
// On an arduino MEGA 2560: 20(SDA), 21(SCL)
// On an arduino LEONARDO:   2(SDA),  3(SCL), ...
#define OLED_RESET     4 // Reset pin # (or -1 if sharing Arduino reset pin)
#define SCREEN_ADDRESS 0x3C ///< See datasheet for Address; 0x3D for 128x64, 0x3C for 128x32
Adafruit_SSD1306 display(SCREEN_WIDTH, SCREEN_HEIGHT, &Wire, OLED_RESET);

#define LOGO_HEIGHT   64
#define LOGO_WIDTH    128


//String messages[] = {"Made you look teehee", "You should take a break"};
char messages[][30] = {
    "Made you look teehee", 
    "You should take a break", 
    "I wonder whats happening", 
    "doing work is for chumps", 
    "Netflix feeling pretty ", 
    "Hi, how are you", 
    "This is a random message", 
    "Hey how are you???", 
    "ERR MSG 291: GO BACK TO WORK"};
int previousTime = 0;
int interval = 10000;
int notiCount = 0;
int prevSwitchState;
int currentTime = 0;
bool pressed;


void setup() {
  Serial.begin(9600);
  pinMode(LIGHT_PIN, OUTPUT);
  pinMode(BUZZER_PIN, OUTPUT);
  pinMode(SWITCH_PIN, INPUT_PULLUP);
  // SSD1306_SWITCHCAPVCC = generate display voltage from 3.3V internally
  if(!display.begin(SSD1306_SWITCHCAPVCC, SCREEN_ADDRESS)) {
    Serial.println(F("SSD1306 allocation failed"));
    for(;;); // Don't proceed, loop forever
  }
  Serial.println("Didnt fail immediately");
  // Show initial display buffer contents on the screen --
  // the library initializes this with an Adafruit splash screen.
  display.clearDisplay();
  display.display();
  delay(500); // Pause for 2 seconds

  // Clear the buffer
  display.clearDisplay();

  // Draw a single pixel in white
  display.drawPixel(10, 10, SSD1306_WHITE);

  // Show the display buffer on the screen. You MUST call display() after
  // drawing commands to make them visible on screen!
  display.display();
  delay(500);
  // display.display() is NOT necessary after every single drawing command,
  // unless that's what you want...rather, you can batch up a bunch of
  // drawing operations and then update the screen all at once by calling
  // display.display(). These examples demonstrate both approaches...
  prevSwitchState = digitalRead(SWITCH_PIN);
  drawNotification();
  //displayRandomMessage();    // Draw scrolling text

}

void loop() {
  pressed = false;
  currentTime = millis();
  if (currentTime - previousTime > interval) {
      Serial.println(currentTime);
      Serial.println(previousTime);
      Serial.println(interval);
      previousTime = millis();
      interval = random(3, 15) * 1000;
      
      
      getNotified();
  }

  //when button is bpressed, look at notifications
  if (digitalRead(SWITCH_PIN) ==HIGH && prevSwitchState == LOW && pressed == false && notiCount > 0) {
    //This means there was a button pressdown occuring
    Serial.println("Button just pressed");
    Serial.println(pressed);
    pressed = true;
    displayRandomMessage();
  }

  
  if (digitalRead(SWITCH_PIN) == HIGH) {
    prevSwitchState = HIGH;
  } else {
    prevSwitchState = LOW;
  } 
}


void getNotified(){
  notiCount++;
  drawNotificationNumber(notiCount);
  //Make a sound
  makeBuzz();
  //Flash the lightk

  digitalWrite(LIGHT_PIN, HIGH);
}


void drawNotificationNumber(int newNum) {
  drawNotification();
  display.setTextSize(2);      // Normal 1:1 pixel scale
//  display.setTextColor(0xF800); // Draw red text
  display.setTextColor(SSD1306_WHITE); // Draw white text
  display.setCursor(100, 10);     // Start at top-left corner
  char cstr[16];
  itoa(newNum, cstr, 10);
  display.write(cstr);
  display.display();
  delay(500);
}

void displayRandomMessage() {
  digitalWrite(LIGHT_PIN, LOW);
  int i = notiCount;
  for (i; i> 0; i--) {
    display.clearDisplay();
    display.setTextSize(2);             // Normal 1:1 pixel scale
    display.setTextColor(SSD1306_WHITE);        // Draw white text
    display.setCursor(0,0);             // Start at top-left corner
    //TODO pick one at random out of the array and display that
    //String displayer = (String)messages[random(9)];
    display.println(messages[random(9)]);
    display.display();
    notiCount--;
    delay(1000);
  }
  interval = 20000;
  drawNotification();
  drawNotificationNumber(notiCount);
  
}



void drawNotification(void) {
  display.clearDisplay();

  display.drawBitmap(
    (display.width()  - LOGO_WIDTH ) / 2,
    (display.height() - LOGO_HEIGHT) / 2,
    notification, LOGO_WIDTH, LOGO_HEIGHT, 1);
  display.display();
}




void makeBuzz(){
  digitalWrite(BUZZER_PIN, HIGH);
  delay(100);
  digitalWrite(BUZZER_PIN, LOW);

  unsigned char i, j;
  for (i = 0 ; i <20; i++) { // Wen a frequency sound
    digitalWrite(BUZZER_PIN, HIGH); // send voice
    delay(2); // Delay 1ms
    digitalWrite(BUZZER_PIN, LOW); // do not send voice
    delay(2); // delay ms
  }
  delay(50);
//  for (i = 0 ; i <20; i++) { // Wen a frequency sound
//    digitalWrite(BUZZER_PIN, HIGH); // send voice
//    delay(2); // Delay 1ms
//    digitalWrite(BUZZER_PIN, LOW); // do not send voice
//    delay(2); // delay ms
//  }
//  delay(50);
  for (i = 0 ; i <40; i++) { // Wen a frequency sound
    digitalWrite(BUZZER_PIN, HIGH); // send voice
    delay(1); // Delay 1ms
    digitalWrite(BUZZER_PIN, LOW); // do not send voice
    delay(1); // delay ms
  }
}
